# ALT register map
Registers are 32-bit, read-write, no defined reset value unless marked. A register's access mark holds for its fields unless they carry their own. Offsets are from the block's base; lines under a group give offsets from that group; [hi:lo] are bit positions; {n}, {i} and the like mark numbered series; 'fields as' and 'values as' point back to an identical list; <NAME> marks a mode.

## Memory map
0x40001000 P
0x40001000 Q
0x40015800 DBG
0x40015C00 DBG2

## P
Base 0x40001000
0x00 SAFE
0x00 DESTRUCTIVE read-clears (alternate view of SAFE)
0x10 PLAIN
0x20 TINYSAFE
0x20 TINYBIT 1-bit read-clears (alternate view of TINYSAFE)

## Q
Base 0x40001000; alternate view of P
0x10 EATS read-modifies

## DBG
Base 0x40015800
Same registers: DBG2 0x40015C00
0x00 IDCODE ro
